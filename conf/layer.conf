## conf/layer.conf
```bitbake
# We have a conf and classes directory, add to BBPATH
BBPATH .= ":${LAYERDIR}"

# We have recipes-* directories, add to BBFILES
BBFILES += "${LAYERDIR}/recipes-*/*/*.bb \
            ${LAYERDIR}/recipes-*/*/*.bbappend"

BBFILE_COLLECTIONS += "meta-fwupd"
BBFILE_PATTERN_meta-fwupd = "^${LAYERDIR}/"
BBFILE_PRIORITY_meta-fwupd = "6"

LAYERDEPENDS_meta-fwupd = "core"
LAYERDEPENDS_meta-fwupd += "openembedded-layer"

LAYERSERIES_COMPAT_meta-fwupd = "hardknott"
```
